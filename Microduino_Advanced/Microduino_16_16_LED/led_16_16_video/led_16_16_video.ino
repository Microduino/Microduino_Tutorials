int latchPin = 10;
//Pin connected to SH_CP of 74HC595
int clockPin = 13;
////Pin connected to DS of 74HC595
int dataPin = 11;

int i,j,n;

long col[]={
  0x80,0x40,0x20,0x10,0x08,0x04,0x02,0x01};

long row[]={
0xEF,0xDF,0x01,0x7F,0x7F,0x03,0x7F,0x7F,
0x00,0x7F,0x7F,0x01,0xBF,0xDF,0xE7,0xF8,
0xFB,0xFD,0xC0,0xFF,0xFF,0xE0,0xFF,0xFF,
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0xFF,0xFF,0xFF,0xFF,0xFF,0xFF,0xFF,0xFF,//！3

};//行列式、阳码、逆向

void setup() {

  pinMode(latchPin, OUTPUT);

}

void loop() {
  for(j=0;j<6;j++)
  {
    for(n=0;n<100;n++)
    {
      //上部分
      for(int i=0;i<8;i++)
      {
        digitalWrite(latchPin, 0);
        shiftOut(dataPin, clockPin, col[i]);  //mask(col)   
        shiftOut(dataPin, clockPin, col[i]&0x00);
        shiftOut(dataPin, clockPin, row[i+16+j*32]);  //row
        shiftOut(dataPin, clockPin, row[i+j*32]);  //row
        digitalWrite(latchPin, 1);
      }
      //下部分
      for(int i=0;i<8;i++)
      {
        digitalWrite(latchPin, 0);
        shiftOut(dataPin, clockPin, col[i]&0x00);  //mask(col)   
        shiftOut(dataPin, clockPin, col[i]);
        shiftOut(dataPin, clockPin, row[i+24+j*32]);  //row
        shiftOut(dataPin, clockPin, row[i+8+j*32]);  //row
        digitalWrite(latchPin, 1);
      }
    }
  }
}
void shiftOut(int myDataPin, int myClockPin, byte myDataOut) {

  int i=0;
  int pinState;
  pinMode(myClockPin, OUTPUT);
  pinMode(myDataPin, OUTPUT);

  digitalWrite(myDataPin, 0);
  digitalWrite(myClockPin, 0);

  for (i=7; i>=0; i--)  {
    digitalWrite(myClockPin, 0);

    if ( myDataOut & (1<<i) ) {
      pinState= 1;
    }
    else {        
      pinState= 0;
    }

    //Sets the pin to HIGH or LOW depending on pinState
    digitalWrite(myDataPin, pinState);
    //register shifts bits on upstroke of clock pin  
    digitalWrite(myClockPin, 1);
    //zero the data pin after shift to prevent bleed through
    digitalWrite(myDataPin, 0);
  }

  digitalWrite(myClockPin, 0);
}





