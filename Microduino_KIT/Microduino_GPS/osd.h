#include "arduino.h"

#include <U8glib.h>
U8GLIB_SSD1306_128X64 u8g(U8G_I2C_OPT_NONE);	// HW SPI Com: CS = 10, A0 = 9 (Hardware Pins are  SCK = 13 and MOSI = 11)

//-------字体设置，大、中、小
#define setFont_L  u8g.setFont(u8g_font_courB14)
#define setFont_M u8g.setFont(u8g_font_fixed_v0r)
#define setFont_S u8g.setFont(u8g_font_chikitar)
/*
font:
 u8g.setFont(u8g_font_7x13)
 u8g.setFont(u8g_font_fixed_v0r);
 u8g.setFont(u8g_font_chikitar);
 u8g.setFont(u8g_font_osb21);
 */

#define u8g_logo_width 128
#define u8g_logo_height 18

const unsigned char u8g_logo_bits[] U8G_PROGMEM =
{
  0x00, 0x00, 0x00, 0x00, 0x00, 0x00, 0x00, 0x00, 0x00, 0x00, 0x00, 0x00,
  0x00, 0x00, 0x00, 0x00, 0x00, 0x00, 0x00, 0x00, 0x00, 0x00, 0x00, 0x00,
  0x00, 0x00, 0x00, 0x00, 0x00, 0x00, 0x00, 0x00, 0x00, 0xC0, 0x01, 0xE0,
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  0x00, 0x00, 0x00, 0x00, 0x00, 0x00, 0x00, 0x00, 0x00, 0x00, 0x00, 0x00
};

boolean b_oled_updata=false;	//按键动作触发OLED

//OLED===================================================
void vooled()
{
  u8g.firstPage();
  do
  {
    setFont_L;
    u8g.setPrintPos(2, 18);

    u8g.print("Speed:");
    if(STA)
    {
      u8g.print(i_Speed[1]);
      setFont_M;
      u8g.print(".");
      u8g.print(i_Speed[0]);
    }
    else
    {
      u8g.print("N/A");
      setFont_S;
      u8g.print("  no fix");
    }

    setFont_M;
    u8g.setPrintPos(2, 32);
    u8g.print("Lat.: ");
    u8g.print( c_lat);
    u8g.print(" ");
    u8g.print( f_latitude,4);

    u8g.setPrintPos(2, 41);
    u8g.print("Lon.: ");
    u8g.print( c_lon);
    u8g.print(" ");
    u8g.print(f_longitude,4);

    u8g.drawLine(0, 44, 128, 44);
    u8g.drawLine(0, 55, 128, 55);

    u8g.setPrintPos(2, 53);
    if(!b_oled_updata)	//按键是否动作
    {
      u8g.print("20");
      u8g.print(idate[0]);
      u8g.print("-");
      u8g.print(idate[1]);
      u8g.print("-");
      u8g.print(idate[2]);

      u8g.print("  ");
      u8g.print(itime[0]);
      u8g.print(":");
      u8g.print(itime[1]);
      u8g.print(":");
      u8g.print(itime[2]);
    }
    else
    {
      u8g.print("Compl.:\"");
      u8g.print(file_name_cache);
      u8g.print("\"");
    }

    //------------------
    u8g.drawFrame(2, 57, 14, 7);
    u8g.drawBox(2, 57, map(_V_bat,_V_min,_V_max,1,14) , 7);
    u8g.drawFrame(16, 59, 2, 3);

    u8g.setPrintPos(24, 64);
    u8g.print("STA :");
    u8g.print(i_satellites);    

    u8g.setPrintPos(72, 64);
    u8g.print("ELE.:");
    u8g.print(int(f_Height));
  }
  while( u8g.nextPage() );
}

void volcdlogo(unsigned int x, unsigned int y)
{
  u8g.firstPage();
  do
  {
    u8g.drawXBMP( x, y, u8g_logo_width, u8g_logo_height, u8g_logo_bits);
  }
  while( u8g.nextPage() );
}
