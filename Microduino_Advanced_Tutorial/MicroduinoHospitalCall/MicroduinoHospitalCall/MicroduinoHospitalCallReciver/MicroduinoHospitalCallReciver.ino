#include <U8glib.h> 
#include <RF24Network.h>
#include <RF24.h>
#include <SPI.h>
#include <SimpleSDAudio.h>


#include <Wire.h> //调用库 

U8GLIB_SSD1306_128X64 u8g(U8G_I2C_OPT_NONE);//定义OLED连接方式


//-------字体设置，大、中、小
#define setFont_L u8g.setFont(u8g_font_fur25)
#define setFont_M u8g.setFont(u8g_font_fixed_v0r)
#define setFont_S u8g.setFont(u8g_font_chikitar) 

#define NUM 2 //number of sensors

// nRF24L01(+) radio attached using Getting Started board 
RF24 radio(9,10);
// Network uses that radio
RF24Network network(radio);
// Address of our node
const uint16_t this_node = 0; 
// Address of the other node
//const uint16_t other_node = 1;

// Address of the other node
const uint16_t other_node[NUM] = {1, 2};

const unsigned char bmp_hospitalCall[] U8G_PROGMEM = 
{
  0x00,0x00,0x00,0x00,0x00,0x00,0xF0,0xFE,0xFF,0xFF,0xFF,0xFF,0xFF,0xFF,0xFE,0xFF,
  0x7F,0xFB,0xFF,0xFF,0xFF,0xFE,0xFF,0xEF,0xFF,0xFD,0xFF,0xFF,0xFE,0xFF,0xFD,0xFF,
  0xEF,0xFF,0xFF,0xFE,0xBF,0xFF,0xFF,0xFF,0xFF,0xFF,0xFE,0xFF,0xFF,0xFF,0x7F,0xFF,
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  0xFF,0xFF,0xFF,0xFF,0xFF
};



// Structure of our payload
struct payload_t {
  uint32_t ms;
  uint32_t sensorDataA;
  uint32_t sensorDataB;
};

#define power_PIN 2
#define led_PIN 5

boolean power_SW;
int bedNum;


void setup(void) {
  Serial.begin(115200);
  SPI.begin();
  radio.begin();
  radio.setDataRate( RF24_250KBPS ) ;
  network.begin(/*channel*/ 50, /*node address*/ this_node);


  // Using F("...") to avoid wasting RAM  
  Serial.print(F("\nInitializing SD card..."));  
  
  // If your SD card CS-Pin is not at Pin 7, enable and adapt the following line:
   SdPlay.setSDCSPin(7);
  
  if (!SdPlay.init(SSDA_MODE_FULLRATE | SSDA_MODE_MONO)) {
    Serial.println(F("initialization failed. Things to check:"));
    Serial.println(F("* is a card is inserted?"));
    Serial.println(F("* Is your wiring correct?"));
    Serial.println(F("* maybe you need to change the chipSelect pin to match your shield or module?"));
    Serial.print(F("Error code: "));
    Serial.println(SdPlay.getLastError());
    while(1);
  } else {
   Serial.println(F("Wiring is correct and a card is present.")); 
  }

  Serial.print(F("Looking for EXAMPLE.AFM... "));
  if(!SdPlay.setFile("EXAMPLE.AFM")) {
    Serial.println(F(" not found on card! Error code: "));
    Serial.println(SdPlay.getLastError());
    while(1);
  } else {
   Serial.println(F("found.")); 
  }  



}

void loop(void) {  
  // Pump the network regularly
  network.update();
  // Is there anything ready for us?
  while ( network.available() ) {
    // If so, grab it and print it out
    RF24NetworkHeader header;
    payload_t payload;
    network.read(header,&payload,sizeof(payload));
    power_SW=payload.sensorDataA;
    bedNum=payload.sensorDataB;
    Serial.println("Received Sensor Data #");

    Serial.print("power_SW:");
    Serial.println(power_SW);
    Serial.print("bedNum:");
    Serial.println(bedNum);

    if(power_SW) {
      u8g.firstPage();
      do {
        draw();
      } while( u8g.nextPage() );
      playSound();
    } 
  }
}


void draw(void) {
  u8g.setDefaultForegroundColor();
  u8g.drawXBMP( 1, 1, 50, 50, bmp_hospitalCall);

  setFont_L; //设置字体为大
  u8g.setPrintPos(70, 30); //设置文字开始坐标
  u8g.print(bedNum , 1); //床号
  
  u8g.setPrintPos(60, 60); //设置文字开始坐标
  u8g.print("call.."); //call
  
}


void clearScreen(void) {
  setFont_L; //设置字体为大
  u8g.setPrintPos(100, 100); //设置文字开始坐标
  u8g.print(0 , 1); //床号
}


void playSound(void) {
  Serial.print(F("Playing... ")); 
  SdPlay.play();
  while(!SdPlay.isStopped()) {
    SdPlay.worker();
  }
  Serial.println(F("done."));
  SdPlay.deInit();
}
