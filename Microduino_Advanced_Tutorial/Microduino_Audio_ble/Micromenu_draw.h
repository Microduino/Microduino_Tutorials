#include "Arduino.h"

#define u8g_logo_width 28
#define u8g_logo_height 36

const unsigned char u8g_logo_bits[] U8G_PROGMEM = {
  0xFC,0xFF,0xFF,0xF3,0xFE,0x07,0xFE,0xF7,0xFF,0x01,0xF8,0xFF,
  0xFF,0x00,0xF0,0xFF,0x7F,0x00,0xE0,0xFF,0x3F,0x00,0xC0,0xFF,
  0x3F,0x01,0xC8,0xFF,0x1F,0xFF,0x8F,0xFF,0x1F,0x01,0x8E,0xFF,
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  0xFF,0x01,0xF8,0xFF,0xFE,0x07,0xFE,0xF7,0xFC,0xFF,0xFF,0xF3
};

//主界面，可自由定义
void drawMain()
{
  u8g.drawXBMP( 4, 6, u8g_logo_width, u8g_logo_height, u8g_logo_bits);

  //setFont_L;
  //u8g.setFont(u8g_font_9x15Br);
  //u8g.setFont(u8g_font_9x18Br);
  u8g.setFont(u8g_font_courB24n);
  u8g.setFontRefHeightText();

  u8g.setPrintPos(42, 8+u8g.getFontAscent()-u8g.getFontDescent());
  if(Hour<10)
    u8g.print("0");
  u8g.print(Hour);

  u8g.setPrintPos(76, 8+u8g.getFontAscent()-u8g.getFontDescent());
  u8g.print(Second%2 ? ":" : " ");

  u8g.setPrintPos(91, 8+u8g.getFontAscent()-u8g.getFontDescent());
  if(Minute<10)
    u8g.print("0");
  u8g.print(Minute);

  setFont_L;
  u8g.setFontRefHeightText();
  u8g.setPrintPos(61, 60);
  if(alarm_hour<10)
    u8g.print("0");
  u8g.print(alarm_hour);
  u8g.setPrintPos(81, 60);
  u8g.print(":");
  u8g.setPrintPos(91, 60);
  if(alarm_minute<10)
    u8g.print("0");
  u8g.print(alarm_minute);

  if(alarm_switch)
  {
    u8g.setPrintPos(6, 60);
    u8g.print("ON");
  }
  else
  {
    u8g.setPrintPos(2, 60);
    u8g.print("OFF");
  }
}



