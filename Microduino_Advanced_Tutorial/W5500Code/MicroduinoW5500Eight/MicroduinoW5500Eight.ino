#include <SPI.h>
#include <Ethernet.h>

#define buffer_NUM 200

#define LED1PIN 2
#define LED2PIN 3
PROGMEM prog_char led_off[]= {
	0x89, 0x50, 0x4E, 0x47, 0x0D, 0x0A, 0x1A, 0x0A, 0x00, 0x00, 0x00, 0x0D, 0x49, 0x48, 0x44, 0x52, 0x00, 0x00, 0x00, 0x0E,
	0x00, 0x00, 0x00, 0x0E, 0x08, 0x04, 0x00, 0x00, 0x00, 0xB5, 0x41, 0xE5, 0x5A, 0x00, 0x00, 0x00, 0x01, 0x73, 0x52, 0x47,
	0x42, 0x00, 0xAE, 0xCE, 0x1C, 0xE9, 0x00, 0x00, 0x00, 0x02, 0x62, 0x4B, 0x47, 0x44, 0x00, 0xFF, 0x87, 0x8F, 0xCC, 0xBF,
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	0x44, 0xCC, 0x00, 0x00, 0x00, 0x00, 0x49, 0x45, 0x4E, 0x44, 0xAE, 0x42, 0x60, 0x82
};
PROGMEM prog_char led_on[]= {
	0x89, 0x50, 0x4E, 0x47, 0x0D, 0x0A, 0x1A, 0x0A, 0x00, 0x00, 0x00, 0x0D, 0x49, 0x48, 0x44, 0x52, 0x00, 0x00, 0x00, 0x0E,
	0x00, 0x00, 0x00, 0x0E, 0x04, 0x03, 0x00, 0x00, 0x00, 0xED, 0x66, 0x30, 0xE2, 0x00, 0x00, 0x00, 0x01, 0x73, 0x52, 0x47,
	0x42, 0x00, 0xAE, 0xCE, 0x1C, 0xE9, 0x00, 0x00, 0x00, 0x27, 0x50, 0x4C, 0x54, 0x45, 0x00, 0x00, 0x00, 0xFF, 0xCC, 0x00,
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	0x56, 0x0B, 0x58, 0x9D, 0x6A, 0x76, 0x99, 0x00, 0x00, 0x00, 0x00, 0x49, 0x45, 0x4E, 0x44, 0xAE, 0x42, 0x60, 0x82
};
// ethernet interface mac address, must be unique on the LAN
// Enter a MAC address and IP address for your controller below.
// The IP address will be dependent on your local network:
byte mac[] = {0xDE, 0xAD, 0xBE, 0xEF, 0xFE, 0xED};
IPAddress ip(192,168,199,123);
IPAddress gateway(192,168,199, 1);
IPAddress subnet(255, 255, 255, 0);

// Initialize the Ethernet server library
// with the IP address and port you want to use 
// (port 80 is default for HTTP):
EthernetServer server(80);
// listen for incoming clients
EthernetClient client;

byte buffer[buffer_NUM];


boolean led1Status=false;
boolean led2Status=false;

void setup () {
	Serial.begin(115200);



	// start the Ethernet connection and the server:
	Ethernet.begin(mac, ip, gateway, subnet);
	server.begin();
	Serial.print("server is at ");
	Serial.println(Ethernet.localIP());

	pinMode(LED1PIN, OUTPUT);
	pinMode(LED2PIN, OUTPUT);
	digitalWrite(LED1PIN, LOW);
	digitalWrite(LED2PIN, LOW);
	led1Status = false;
	led2Status = false;
}


void loop () {
  word len;
  // listen for incoming clients
  client = server.available();
  if (client) {
    Serial.println("new client");
    // an http request ends with a blank line
    boolean currentLineIsBlank = true;
    while (client.connected()) {
      if (client.available()) {
        char c = client.read();
        buffer[len] = c;
        len++;
        if (c == '\n' && currentLineIsBlank) {

          Ethernet_data();
          break;
        }
        if (c == '\n') {
          // you're starting a new line
          currentLineIsBlank = true;
        } 
        else if (c != '\r') {
          // you've gotten a character on the current line
          currentLineIsBlank = false;
        }
      }
    }
    len=0;
    for(int i=0; i<buffer_NUM; i++)
      Serial.write(buffer[i]);
    // give the web browser time to receive the data
    delay(1);
    // close the connection:
    client.stop();
    Serial.println("client disonnected");
  }
}



void send_png_image(PGM_P png_image, unsigned int image_size) {
	client.println("HTTP/1.0 200 OK\r\n");
	client.println("Content-Type: image/png\r\n\r\n");

	//client.println(png_image, image_size);
	//client.write((uint8_t*)png_image, image_size);

}


boolean Ethernet_data() {

	if(strstr((char *)buffer, "GET /led_off.png") != 0) {
		//send_png_image(led_off, sizeof(led_off));
	}
	else if(strstr((char *)buffer, "GET /led_on.png") != 0) {
		//send_png_image(led_on, sizeof(led_on));
	} else {
		if(strstr((char *)buffer, "GET /?LED1") != 0) {
			led1Status = !led1Status;
			digitalWrite(LED1PIN, led1Status);
		}
		if(strstr((char *)buffer, "GET /?LED2") != 0) {
			led2Status = !led2Status;
			digitalWrite(LED2PIN, led2Status);
		}
		Ethernet_post();
	}
}



void Ethernet_post() {

	client.println("HTTP/1.0 200 OK");
	client.println("Content-Type: text/html\r\nPragma: no-cache\r\n");
	client.println("<html><head><title>WebLeds</title></head><body>");
	client.println("Toggle leds: ");

	if(led1Status) {
		client.println("<a href=\"/?LED1\"><img src=\"led_on.png\"></a>");
	} else {
		client.println("<a href=\"/?LED1\"><img src=\"led_off.png\"></a>");
	}
	if(led2Status) {
		client.println("<a href=\"/?LED2\"><img src=\"led_on.png\"></a>");
	} else {
		client.println("<a href=\"/?LED2\"><img src=\"led_off.png\"></a>");
	}
	client.println("</body></html>");
}
